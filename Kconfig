## Kconfig
```kconfig
mainmenu "Calypso OS/$ARCH Configuration"

menu "Board Setup"
source include/Kconfig
endmenu # Build Setup

menu "OS Features"

config POWERON_MESSAGE
	string "The message that will be prinyted on console when the system boots"
	default "\r\nWelcome to Calypso OS\r\n"

config FATFS_SUPPORT
	bool "Build the FatFS library"
	default n

config WORKER_STACK_SIZE
	int "Default stack size for the worker thread"
	default 2048

config SEPARATE_BUNDLES
	bool "Separate the kernel image from the apps bundle"
	default n
	---help---
	  Build the kernel as a separate image and allow apps to use the
	  system call interface to interact with the kernel services.
	  Applications will use the functions exported from "exported_syscall.h"
	  header and will link to some arch specific wrappers that trigger the
	  jump from kernel to userspace.

endmenu

menu "Device Drivers"
source drivers/Kconfig
endmenu

menu "Libraries"
source lib/Kconfig
endmenu

menu "Scheduler Configuration"
source sched/Kconfig
endmenu

menu "Application Configuration"
source "apps/Kconfig"
endmenu
```

## apps/Kconfig
```kconfig
config RUN_APPS_IN_OWN_THREAD
  bool "Run applications/console commands in there own thread"
  default n
  ---help---
  Allow applications to run the entry_point functions in their own thread.

config CONSOLE_APP
	bool "Basic console support"
	default n
	---help---
	This application runs in it's own thread and contains a suite of
	command tools that can be enabled indipendently.

if CONSOLE_APP

config CONSOLE_STACK_SIZE
	int "The stack size"
	default 2048

config CONSOLE_PROMPT_STR
	string "The default console prompt"
	default "root:#>"

config CONSOLE_ECHO_ON
	bool "Typing is echoed back to console"
	default n

config CONSOLE_DATE_ON
	bool "Tool to set/view the system time"
	default n

config CONSOLE_CAT
	bool "Tool to print files to console output"
	default n

config CONSOLE_FREE
	bool "Tool used to view the free HEAP memory"
	default n

config CONSOLE_LS
	bool "List the directories and files"
	default n

config CONSOLE_MOUNT
	bool "Tool used to mount new file systems"
	default n

config CONSOLE_SENSOR_MEASURE
  bool "Tool to read the gas sensor data"
  default n

if CONSOLE_SENSOR_MEASURE

config SENSOR_LOG
  bool "Log the sensor data"
  default n

config SENSOR_LOG_FILENAME
  string "The path used to log BME680 data"
  default "/mnt/LOGGER.CSV"

config CONSOLE_SENSOR_MEASURE_STACKSIZE
  int "Stack size in bytes"
  default 4096

endif # CONSOLE_SENSOR_MEASURE

config CONSOLE_SLEEP
  bool "Sleep the console for the specified interval"
  default n

config CONSOLE_ECHO
  bool "Echo a message to the console"
  default n

config CONSOLE_RM
  bool "Remove file console tool"
  default n

if !TIMER_DRIVER && !RTC_DRIVER
config CONSOLE_NRF_INIT_SOFTDEVICE_APP
  bool "Start nordic soft device application"
  default n
  ---help---
  The application can be started from console when this is enabled. There are
  some dependecies to get this working: soft device should be flashed on the
  nrf5X board before having this enabled (make flash_softdevice from softdevice
  folder).

if CONSOLE_NRF_INIT_SOFTDEVICE_APP
config CONSOLE_NRF_INIT_SOFTDEVICE_APP_STACK_SIZE
  int "Stack size in bytes"
  default 8192
endif

endif
endif # CONSOLE_APP
```

## arch/arm/nrf5x/Kconfig
```kconfig
config MACHINE_TYPE
    string "The machine name"
    default "nrf52840"

config MACHINE_CPU
		string "The ARM cpu family"
		default "Cortex_M4"

config CFLAGS
    string "The compilation flags"
    default '  -mcpu=cortex-m4 -mthumb -mabi=aapcs -O -ggdb -std=gnu99 '

config LDFLAGS
    string "The linker flags"
    default ' ${CFLAGS} -nostartfiles -nodefaultlibs -Wl -T${TOPDIR}/linker.ld'

config SPI_0
    bool "SPI master 0 peripheral support"
    default n

if SPI_0

config SPI_0_MISO_PIN
    int "SPI 0 MISO pin"
    default 0

config SPI_0_MISO_PORT
    int "SPI 0 MISO port"
    default 0

config SPI_0_MOSI_PIN
    int "SPI 0 MOSI pin"
    default 0

config SPI_0_MOSI_PORT
    int "SPI 0 MOSI port"
    default 0

config SPI_0_SCK_PIN
    int "SPI 0 SCK pin"
    default 0

config SPI_0_SCK_PORT
    int "SPI 0 SCK port"
    default 0

config SPI_0_CS_PIN
    int "SPI 0 CS pin"
    default 0

config SPI_0_CS_PORT
    int "SPI 0 CS port"
    default 0

config SPI_0_FREQUENCY
    int "SPI 0 Master clock frequency [0 .. 6]"
    default 0
    ---help---
    The SPI master clock frequency { 0 = 125 KBPS, 1 = 250 KBSP, 2 = 500 KBPS,
    3 = 1 MBPS, 4 = 2 MBPS, 5 = 4 MBSP, 6 = 8 MBPS }

endif # SPI_0

config SPI_1
    bool "SPI master 1 peripheral support"
    default n

if SPI_1

config SPI_1_MISO_PIN
    int "SPI 1 MISO pin"
    default 0

config SPI_1_MISO_PORT
    int "SPI 1 MISO port"
    default 0

config SPI_1_MOSI_PIN
    int "SPI 1 MOSI pin"
    default 0

config SPI_1_MOSI_PORT
    int "SPI 1 MOSI port"
    default 0

config SPI_1_SCK_PIN
    int "SPI 1 SCK pin"
    default 0

config SPI_1_SCK_PORT
    int "SPI 1 SCK port"
    default 0

config SPI_1_CS_PIN
    int "SPI 1 CS pin"
    default 0

config SPI_1_CS_PORT
    int "SPI 1 CS port"
    default 0

config SPI_1_FREQUENCY
    int "SPI 1 Master clock frequency [0 .. 6]"
    default 0
    ---help---
    The SPI master clock frequency { 0 = 125 KBPS, 1 = 250 KBSP, 2 = 500 KBPS,
    3 = 1 MBPS, 4 = 2 MBPS, 5 = 4 MBSP, 6 = 8 MBPS }

endif # SPI_1

config SPI_BUFFER_LEN
    int "SPI Buffer len in bytes"
    default 32

config CONSOLE_UART_PATH
    string "The path where we mount the serial console node"
    default "/dev/ttyUSB0"

config SERIAL_CONSOLE_TX
    int "The TX serial console pin"
    default 6

config SERIAL_CONSOLE_RX
    int "The RX serial console pin"
    default 8

config RTC_PATH
    string "The path where we mount the rtc driver node"
    default "/dev/rtc0"

config RAM_BASE
    hex "The start of the SRAM"
    default 0x2000000

config RAM_LENGTH
    hex "The length of the SRAM memory in bytes"
    default 0x10000

config HARDWARE_FP
    bool "Hardware floating point instructions"
    default y
```

## arch/arm/versatilepb/Kconfig
```kconfig
config MACHINE_TYPE
    string "The machine name"
    default "versatilepb"

config PREFIX_TOOLCHAIN
    string "The prefix used by the toolchain"
    default "arm-none-eabi-"

config COMMAND_LOAD
    string "The command used to load the binnary on the board"
    default "qemu-system-arm -M versatilepb -m 128M -nographic -kernel build/build.bin"

config CFLAGS
    string "The compilation flags"
    default ''

config LDFLAGS
    string "The linker flags"
    default ''

config SPI_0
    bool "SPI master 0 peripheral support"
    default n

if SPI_0

config SPI_0_MISO_PIN
    int "SPI 0 MISO pin"
    default 0

config SPI_0_MISO_PORT
    int "SPI 0 MISO port"
    default 0

config SPI_0_MOSI_PIN
    int "SPI 0 MOSI pin"
    default 0

config SPI_0_MOSI_PORT
    int "SPI 0 MOSI port"
    default 0

config SPI_0_SCK_PIN
    int "SPI 0 SCK pin"
    default 0

config SPI_0_SCK_PORT
    int "SPI 0 SCK port"
    default 0

config SPI_0_CS_PIN
    int "SPI 0 CS pin"
    default 0

config SPI_0_CS_PORT
    int "SPI 0 CS port"
    default 0

config SPI_0_FREQUENCY
    int "SPI 0 Master clock frequency [0 .. 6]"
    default 0
    ---help---
    The SPI master clock frequency { 0 = 125 KBPS, 1 = 250 KBSP, 2 = 500 KBPS,
    3 = 1 MBPS, 4 = 2 MBPS, 5 = 4 MBSP, 6 = 8 MBPS }

endif # SPI_0

config SPI_1
    bool "SPI master 1 peripheral support"
    default n

if SPI_1

config SPI_1_MISO_PIN
    int "SPI 1 MISO pin"
    default 0

config SPI_1_MISO_PORT
    int "SPI 1 MISO port"
    default 0

config SPI_1_MOSI_PIN
    int "SPI 1 MOSI pin"
    default 0

config SPI_1_MOSI_PORT
    int "SPI 1 MOSI port"
    default 0

config SPI_1_SCK_PIN
    int "SPI 1 SCK pin"
    default 0

config SPI_1_SCK_PORT
    int "SPI 1 SCK port"
    default 0

config SPI_1_CS_PIN
    int "SPI 1 CS pin"
    default 0

config SPI_1_CS_PORT
    int "SPI 1 CS port"
    default 0

config SPI_1_FREQUENCY
    int "SPI 1 Master clock frequency [0 .. 6]"
    default 0
    ---help---
    The SPI master clock frequency { 0 = 125 KBPS, 1 = 250 KBSP, 2 = 500 KBPS,
    3 = 1 MBPS, 4 = 2 MBPS, 5 = 4 MBSP, 6 = 8 MBPS }

endif # SPI_1

config SPI_BUFFER_LEN
    int "SPI Buffer len in bytes"
    default 32

config CONSOLE_UART_PATH
    string "The path where we mount the serial console node"
    default "/dev/ttyUSB0"

config SERIAL_CONSOLE_TX
    int "The TX serial console pin"
    default 6

config SERIAL_CONSOLE_RX
    int "The RX serial console pin"
    default 8

config RTC_PATH
    string "The path where we mount the rtc driver node"
    default "/dev/rtc0"
```

## arch/sim/sim/Kconfig
```kconfig
config MACHINE_TYPE
    string "The machine name"
    default "sim"

config MACHINE_CPU
    string "The cpu family"
    default "x86_64"

config HOST_OS
    string "The host OS"
    default "Darwin"
    ---help---
      This configuration identifies the host platform that we are building on
      and is used in the Makefiles to use the correct compilation options.
      It can be Darwin | Linux, currently we don't support Windows.

config SIM_BUILD
    bool "Simulator build"
    default y

config SIM_HEAP_SIZE
    int "Simulation heap size in bytes"
    default 1048576
    ---help---
      The heap memory region size in bytes. From this heap we allocate all
      the system's resources such as task stack, open files, virtual file
      system and so on.

config PREFIX_TOOLCHAIN
    string "The prefix used by the toolchain"
    default ""

config TWO_PASS_BUILD
    bool "Build a partial linked file first and then link all together"
    default y
    ---help---
      Set this option to true to allow building a partially linked file that
      contains the OS symbols and a separate file that links to the host
      symbols. Link them both at the end.

config SIMULATED_FLASH
    bool "Support for the simulated flash device"
    default y

config SIM_FLASH_NAME
    string "The path of the mounted simulated flash in the VFS"
    default "/dev/sim_flash"
    ---help---
      This is the path of the simulated mounted flash device.

config COMMAND_LOAD
    string "The command used to load the binnary on the board"
    default ""

config CFLAGS
    string "The compilation flags"
    default '  -mcpu=cortex-m4 -mthumb -mabi=aapcs -O -ggdb -std=gnu99 '

config LDFLAGS
    string "The linker flags"
    default ' ${CFLAGS} -nostartfiles -nodefaultlibs -Wl -T${TOPDIR}/linker.ld'

config UART_PERIPHERAL_0
  bool "Support for uart peripheral 0"
  default y

if UART_PERIPHERAL_0
config SERIAL_CONSOLE_BAUDRATE
    hex "The baudrate for the serial console peripheral"
    default 0x01D60000
    ---help---
    Other possible values can be: 0x0004F000 - baud1200
    0x0009D000 - baud 2400, 0x0013B000 - baud 4800
    0x00275000 - baud 9600.

config CONSOLE_UART_PATH
    string "The path where we mount the serial console node"
    default "/dev/ttyUSB0"

config SERIAL_CONSOLE_TX_PIN
    int "The TX serial console pin"
    default 6

config SERIAL_CONSOLE_TX_PORT
    int "The TX serial console port"
    default 0

config SERIAL_CONSOLE_RX_PIN
    int "The RX serial console pin"
    default 8

config SERIAL_CONSOLE_RX_PORT
    int "The RX serial console port"
    default 0
endif

config UART_PERIPHERAL_1
  bool "Support for uart peripheral 1"
  default n

if UART_PERIPHERAL_1

config UART_PERIPHERAL_1_PATH
  string "The path where we mount the second UART peripheral"
  default "/dev/ttyUSB1"

config UART_PERIPHERAL_1_BAUDRATE
    hex "The baudrate for the serial console peripheral"
    default 0x01D60000
    ---help---
    Other possible values can be: 0x0004F000 - baud1200
    0x0009D000 - baud 2400, 0x0013B000 - baud 4800
    0x00275000 - baud 9600.

config UART_PERIPHERAL_1_TX_PIN
    int "The TX serial console pin"
    default 9

config UART_PERIPHERAL_1_TX_PORT
    int "The TX serial console port"
    default 0

config UART_PERIPHERAL_1_RX_PIN
    int "The RX serial console pin"
    default 10

config UART_PERIPHERAL_1_RX_PORT
    int "The RX serial console port"
    default 0
endif

config RTC_PATH
    string "The path where we mount the rtc driver node"
    default "/dev/rtc0"

config RUN_FROM_RAM
    bool "Select this if you don't want to copy the data segment into RAM"
    default y
```
