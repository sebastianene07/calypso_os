## arch/xtensa/lx6/Kconfig
```kconfig
config MACHINE_TYPE
    string "The machine name"
    default "nrf52840"

config MACHINE_CPU
		string "The ARM cpu family"
		default "Cortex_M4"

config PREFIX_TOOLCHAIN
    string "The prefix used by th toolchain"
    default "xtensa-esp32-elf-"

config CFLAGS
    string "The compilation flags"
    default '  -mcpu=cortex-m4 -mthumb -mabi=aapcs -O -ggdb -std=gnu99 '

config LDFLAGS
    string "The linker flags"
    default ' ${CFLAGS} -nostartfiles -nodefaultlibs -Wl -T${TOPDIR}/linker.ld'

config SPI_0
    bool "SPI master 0 peripheral support"
    default n

if SPI_0

config SPI_0_MISO_PIN
    int "SPI 0 MISO pin"
    default 0

config SPI_0_MISO_PORT
    int "SPI 0 MISO port"
    default 0

config SPI_0_MOSI_PIN
    int "SPI 0 MOSI pin"
    default 0

config SPI_0_MOSI_PORT
    int "SPI 0 MOSI port"
    default 0

config SPI_0_SCK_PIN
    int "SPI 0 SCK pin"
    default 0

config SPI_0_SCK_PORT
    int "SPI 0 SCK port"
    default 0

config SPI_0_CS_PIN
    int "SPI 0 CS pin"
    default 0

config SPI_0_CS_PORT
    int "SPI 0 CS port"
    default 0

config SPI_0_FREQUENCY
    int "SPI 0 Master clock frequency [0 .. 6]"
    default 0
    ---help---
    The SPI master clock frequency { 0 = 125 KBPS, 1 = 250 KBSP, 2 = 500 KBPS,
    3 = 1 MBPS, 4 = 2 MBPS, 5 = 4 MBSP, 6 = 8 MBPS }

endif # SPI_0

config SPI_1
    bool "SPI master 1 peripheral support"
    default n

if SPI_1

config SPI_1_MISO_PIN
    int "SPI 1 MISO pin"
    default 0

config SPI_1_MISO_PORT
    int "SPI 1 MISO port"
    default 0

config SPI_1_MOSI_PIN
    int "SPI 1 MOSI pin"
    default 0

config SPI_1_MOSI_PORT
    int "SPI 1 MOSI port"
    default 0

config SPI_1_SCK_PIN
    int "SPI 1 SCK pin"
    default 0

config SPI_1_SCK_PORT
    int "SPI 1 SCK port"
    default 0

config SPI_1_CS_PIN
    int "SPI 1 CS pin"
    default 0

config SPI_1_CS_PORT
    int "SPI 1 CS port"
    default 0

config SPI_1_FREQUENCY
    int "SPI 1 Master clock frequency [0 .. 6]"
    default 0
    ---help---
    The SPI master clock frequency { 0 = 125 KBPS, 1 = 250 KBSP, 2 = 500 KBPS,
    3 = 1 MBPS, 4 = 2 MBPS, 5 = 4 MBSP, 6 = 8 MBPS }

endif # SPI_1

config SPI_BUFFER_LEN
    int "SPI Buffer len in bytes"
    default 32

config UART_PERIPHERAL_0
  bool "Support for uart peripheral 0"
  default y

if UART_PERIPHERAL_0
config SERIAL_CONSOLE_BAUDRATE
    hex "The baudrate for the serial console peripheral"
    default 0x01D60000
    ---help---
    Other possible values can be: 0x0004F000 - baud1200
    0x0009D000 - baud 2400, 0x0013B000 - baud 4800
    0x00275000 - baud 9600.

config CONSOLE_UART_PATH
    string "The path where we mount the serial console node"
    default "/dev/ttyUSB0"

config SERIAL_CONSOLE_TX_PIN
    int "The TX serial console pin"
    default 6

config SERIAL_CONSOLE_TX_PORT
    int "The TX serial console port"
    default 0

config SERIAL_CONSOLE_RX_PIN
    int "The RX serial console pin"
    default 8

config SERIAL_CONSOLE_RX_PORT
    int "The RX serial console port"
    default 0
endif

config UART_PERIPHERAL_1
  bool "Support for uart peripheral 1"
  default n

if UART_PERIPHERAL_1

config UART_PERIPHERAL_1_PATH
  string "The path where we mount the second UART peripheral"
  default "/dev/ttyUSB1"

config UART_PERIPHERAL_1_BAUDRATE
    hex "The baudrate for the serial console peripheral"
    default 0x01D60000
    ---help---
    Other possible values can be: 0x0004F000 - baud1200
    0x0009D000 - baud 2400, 0x0013B000 - baud 4800
    0x00275000 - baud 9600.

config UART_PERIPHERAL_1_TX_PIN
    int "The TX serial console pin"
    default 9

config UART_PERIPHERAL_1_TX_PORT
    int "The TX serial console port"
    default 0

config UART_PERIPHERAL_1_RX_PIN
    int "The RX serial console pin"
    default 10

config UART_PERIPHERAL_1_RX_PORT
    int "The RX serial console port"
    default 0
endif

config RTC_PATH
    string "The path where we mount the rtc driver node"
    default "/dev/rtc0"

config RAM_BASE
    hex "The start of the SRAM"
    default 0x2000000

config RAM_LENGTH
    hex "The length of the SRAM memory in bytes"
    default 0x10000

config HARDWARE_FP
    bool "Hardware floating point instructions"
    default n

config NRF5X_RTC
  bool "Support for nordic real time clock"
  select RTC_DRIVER
  default n

config NRF5X_TIMER
  bool "Support for nordic timers"
  select TIMER_DRIVER
  default n

config NRF5X_CLOCK
  bool "Configure the nordic clock source"
  default n
```

## config/raspberrypi/release/defconfig
```kconfig
MACHINE_TYPE=nrf52840
CFLAGS= -mcpu=cortex-m4 -mthumb -mabi=aapcs -O -ggdb
LDFLAGS= ${CFLAGS} -nostartfiles -nodefaultlibs -Wl,-T${TOPDIR}/linker.ld
CONFIG_CONSOLE_APP=y
```

## drivers/Kconfig
```kconfig
####### Display Drivers ########
###############################

config DISPLAY_DRIVERS
	bool "Display drivers"
	default n
	---help---
	Select which display drivers you want to build.

if DISPLAY_DRIVERS
source drivers/display/Kconfig
endif # DISPLAY_DRIVERS

####### Serial Drivers ########
###############################

config SERIAL_DRIVERS
	bool "Serial drivers"
	default n
	---help---
	Select the serial driver taht you want to build.

if SERIAL_DRIVERS
endif # SERIAL_DRIVERS

####### Storage Drivers #######
###############################

config STORAGE_DRIVERS
	bool "Storage drivers"
	default n
	---help---
	Select which storage driver you want to build.

if STORAGE_DRIVERS
source drivers/storage/Kconfig
endif # STORAGE_DRIVERS

####### Sensor Drivers #######
###############################

config SENSOR_DRIVERS
	bool "Sensor drivers"
	default n
	---help---
	Select which sensor driver you want to build.

if SENSOR_DRIVERS
source drivers/sensors/Kconfig
endif # SENSOR_DRIVERS
```

## drivers/display/Kconfig
```kconfig
config DISPLY_DRIVER_SSD1331
	bool "Display driver for SSD1331 controller"
	default n
	depends on SPI_0 || SPI_1 || SPI_2

if DISPLY_DRIVER_SSD1331

config DISPLAY_DRIVER_SSD1331_SPI_ID
	int "Select which SPI interface to use [0:2]"
	default 0
endif
```

## drivers/sensors/Kconfig
```kconfig
config SENSOR_BME680
	bool "Bosch sensor BME680"
	default n

if SENSOR_BME680
config SENSOR_BME680_PATH_NAME
  string "The path where we register the sensor"
  default "/dev/bme680"
endif

config SENSOR_BME680_SPI_ID
	int "Select which SPI interface to use [0:2]"
	default 1

config SENSOR_PMSA003
	bool "Plantower PMSA003 sensor"
	default n

if SENSOR_PMSA003
config SENSOR_PMSA003_PATH_NAME
	string "The path where we register the sensor"
	default "/dev/pmsa003"

config SENSOR_PSMA003_UART_ID
	int "Select the uart bus number where the sensor is connected"
	default 1
	---help---
	This specifies the UART peripheral index that this sensor is connected
	to.
endif
```

## drivers/storage/Kconfig
```kconfig
config SPI_SDCARD
	bool "SPI SdCard driver"
	default n
	depends on SPI_0 || SPI_1 || SPI_2

if SPI_SDCARD

config SPI_SDCARD_SPI_ID
	int "Select which SPI interface to use [0:2]"
	default 0

config SPI_SDCARD_VSYS_PORT
	int "Select the port for power supply"
	default 0

config SPI_SDCARD_VSYS_PIN
	int "Select the pin for power supply"
	default 0

config SD_SPI_NAME
	string "The path where we mount the device node"
	default "/dev/sd_spi"

endif
```

## lib/Kconfig
```kconfig
config LIBRARY_BSEC
  bool "Bosch sensor library"
  default n
  ---help---
  Build the Bosch sensor library (BSEC library).

config LIBRARY_FATFS
  bool "Fat/Ex-Fat file system library"
  ---help---
  Build the ChaN generic Fat file-system library.
```

## sched/Kconfig
```kconfig
config SYSTEM_CLOCK_FREQUENCY
  int "Clock tick frequency in MhZ"
  default 200
  ---help---
    The system core clock frequency in MhZ.

config SYSTEM_SCHEDULER_SLICE_FREQUENCY
  int "The pre-emption interrupt frequency in Hz"
  default 2000

config SCHEDULER_IDLE_TASK_STACK_SIZE
  int "The stack size for idle task"
  default 1024

config SCHEDULER_DEBUG
  bool "Show debug messages from the scheduler"
  default n
  ---help---
    When this is enabled it will show the scheduled task name
    and the task states.

config SCHEDULER_TASK_COLORATION
  bool "Fill the stack of the new created application with 0xDEADBEEF"
  default y

config TASK_NAME_LEN
  int "The max size of the task name in bytes"
  default 32

config BOARD_SLEEP
bool "Support for the board sleep"
  default n
  ---help---
  This should be enabled if the board supports sleep functionality.
```
